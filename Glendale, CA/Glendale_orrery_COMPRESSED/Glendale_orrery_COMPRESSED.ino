/*

Arduino program to drive a servo motor indicating when the moon is above the horizon in Philadelphia, PA (39°57′N 75°10′W).
All time values are in UTC.

*/


#include "String.h"
#include "Wire.h"
#include "Servo.h"
#include <avr/pgmspace.h>


#define DS1307_I2C_ADDRESS 0x68
#define ledPin 13

int lastSecond = 0;
int pos = 0;
int UP = 115;
int DOWN = 25;

Servo myservo;

long convertedDate;
long lastEvent;
unsigned long horizonTimeLong;

int moonLength = 4043;    //    This is the number of data entries in the moon array below;

int MOON = 0;
int previousMoon = 0;


// The data entries below capture when the moon dips below the horion and when it rises above the horizon.
// The array begins with a moon set and then alternates between moon sets and moon rises. Each entry is a time stamp in this format: YYMMDDHHMM. 
// So if the moon rises on July 4th, 12 at 9:42AM, the entry would look like this...
//                                          1207040942
// ... and be at an ODD index in the array.

const PROGMEM uint32_t moon[]={


// position 0 is always zero!

1604100514, 1604101612, 1604110619, 1604111705, 1604120719, 1604121801, 1604130813, 1604131858, 1604140902, 1604141955, 1604150945, 1604152052,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 1605080358, 
1605081450, 1605090503, 1605091546, 1605100602, 1605101645, 1605110655, 1605111744, 1605120742, 1605121843, 1605130824, 1605131940, 1605140901,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 1606012318, 
1606021058, 1606030027, 1606031144, 1606040136, 1606041234, 1606050242, 1606051329, 1606060345, 1606061427, 1606070443, 1606071528, 1606080534,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 1606261857, 
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2112142208, 2112151143, 2112152237, 2112161240, 2112162309, 2112171338, 2112172345, 2112181435, 2112190027, 2112191530, 2112200115, 2112201621,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 202112312254

};


int checker(long DATE) {
    Serial.println("Inside checker()");
    int currentValue = 0;
    int i;
    for (i=0; i < moonLength; i++) {
        horizonTimeLong = pgm_read_dword_near(moon + i);
        Serial.print("moon array index number ");
        Serial.print(i);
        Serial.print( " is ");
        Serial.println(horizonTimeLong);
        if (horizonTimeLong <= DATE) {
            lastEvent = horizonTimeLong;
            if (i % 2 == 0) {
              currentValue = 0;
            } else {
              currentValue = 1;
            }
            Serial.print("lastEvent already happened: ");
            Serial.print(lastEvent);
            Serial.print(" : ");
            Serial.println(horizonTimeLong);
            Serial.print("currentValue is ");
            Serial.println(currentValue);
        } else {
          break;
        }
    }
    
    return currentValue;

}

// Convert normal decimal numbers to binary coded decimal
byte decToBcd(byte val)
{
    return ( (val/10*16) + (val%10) );
}

// Convert binary coded decimal to normal decimal numbers
byte bcdToDec(byte val)
{
    return ( (val/16*10) + (val%16) );
}

// Convert binary coded decimal to normal decimal numbers
long bcdToLong(byte val)
{
    return ( (val/16*10) + (val%16) );
}



// Gets the date and time from the ds1307
void getDateDs1307(long *second,
long *minute,
long *hour,
long *dayOfWeek,
long *dayOfMonth,
long *month,
long *year)
{

    // Reset the register pointer
    Wire.beginTransmission(DS1307_I2C_ADDRESS);
    Wire.write(0);
    Wire.endTransmission();
    Wire.requestFrom(DS1307_I2C_ADDRESS, 7);

    // A few of these need masks because certain bits are control bits
    *second     = bcdToLong(Wire.read() & 0x7f);
    *minute     = bcdToLong(Wire.read());
    *hour       = bcdToLong(Wire.read() & 0x3f);  // Need to change this if 12 hour am/pm
    *dayOfWeek  = bcdToLong(Wire.read());
    *dayOfMonth = bcdToLong(Wire.read());
    *month      = bcdToLong(Wire.read());
    *year       = bcdToLong(Wire.read());
}




void setup() {


    myservo.attach(9);

    delay(5000);

    pinMode(ledPin, OUTPUT);
    Serial.begin(9600); 
    Wire.begin();
    Serial.println("Moon orrery for Glendale, CA.");
    Serial.println("Starting...");

    myservo.write(DOWN);
    Serial.println("Servo should be DOWN");
    delay(2000);
    myservo.write(UP);
    Serial.println("Servo should be UP");
    delay(2000);
    myservo.write(DOWN);
    Serial.println("Servo should be DOWN");
    delay(2000);
    myservo.write(UP);
    Serial.println("Servo should be UP");
    delay(2000);
    myservo.write(DOWN);
    Serial.println("Servo should be DOWN");
    delay(2000);



}

void loop() {
  
  Serial.println("In the loop...");
  if (myservo.attached()) {
    Serial.println("Right now the servo is attached.");
  } else {
    Serial.println("Right now the servo is NOT attached.");
  }
    long second, minute, hour, dayOfWeek, dayOfMonth, month, year;

    getDateDs1307(&second, &minute, &hour, &dayOfWeek, &dayOfMonth, &month, &year);

    Serial.print(hour, DEC);
    Serial.print(":");
    if (minute < 10) {
        Serial.print("0");
    }
    Serial.print(minute, DEC);
    Serial.print(":");
    if (second < 10) {
        Serial.print("0");
    }
    Serial.print(second, DEC);
    Serial.print("  ");
    Serial.print(month, DEC);
    Serial.print("/");
    if (dayOfMonth < 10) {
        Serial.print("0");
    }
    Serial.print(dayOfMonth, DEC);
    Serial.print("/");
    Serial.print(year + 2000, DEC);
    Serial.print("  Day_of_week:");
    Serial.println(dayOfWeek, DEC);

    //7 12 16 33

    convertedDate = year * 100000000;
    convertedDate = convertedDate + (month * 1000000);
    convertedDate = convertedDate + (dayOfMonth * 10000);
    convertedDate = convertedDate + (hour * 100);
    convertedDate = convertedDate + (minute);
    Serial.print("Current time is ");
    Serial.println(convertedDate);


    MOON = checker(convertedDate);
    Serial.print("Last event was  ");
    Serial.print(lastEvent);
    Serial.print(" and the current time is ");
    Serial.println(convertedDate);
    Serial.print("I think the moon should be ");
    Serial.println(MOON);
    Serial.println();

    if (MOON == previousMoon) {
      if(myservo.attached()) {
        myservo.detach();
        Serial.println("servo should be detatched.");
      }
    } else {
      myservo.attach(9);
      if (MOON == 0) {
          myservo.write(DOWN);
      } 
      else {
          myservo.write(UP);
      }
      previousMoon = MOON;
    }

    delay(5000);

}



